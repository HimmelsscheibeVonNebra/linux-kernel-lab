## buildroot-external/Config.in
```kconfig
source "$BR2_EXTERNAL_KERNELLAB_PATH/package/kernellab-modules/Config.in"
source "$BR2_EXTERNAL_KERNELLAB_PATH/package/sysprog-examples/Config.in"
source "$BR2_EXTERNAL_KERNELLAB_PATH/package/native-toolchain/Config.in"
```

## buildroot-external/package/kernellab-modules/Config.in
```kconfig
config BR2_PACKAGE_KERNELLAB_MODULES
	bool "kernellab-modules"
	depends on BR2_LINUX_KERNEL
	help
	  Exercise kernel modules of the Linux Kernel Lab
	  (sources live in exercises/ at the repository root).

comment "kernellab-modules needs a Linux kernel to be built"
	depends on !BR2_LINUX_KERNEL
```

## buildroot-external/package/native-toolchain/Config.in
```kconfig
config BR2_PACKAGE_NATIVE_TOOLCHAIN
	bool "native-toolchain"
	depends on BR2_INSTALL_LIBSTDCPP # gcc is written in C++
	help
	  gcc and binutils that run on the target, with the target's
	  glibc headers and libraries as their sysroot. Installed to
	  images/toolchain/ (not the rootfs); the lab serves it to the
	  guest over 9p and mounts it at /opt/gcc.

comment "native-toolchain needs a toolchain w/ C++"
	depends on !BR2_INSTALL_LIBSTDCPP
```

## buildroot-external/package/sysprog-examples/Config.in
```kconfig
config BR2_PACKAGE_SYSPROG_EXAMPLES
	bool "sysprog-examples"
	help
	  User-space system programming examples (sources live in
	  sysprog/ at the repository root), installed with their
	  sources under /home/student/<class>/.
```
